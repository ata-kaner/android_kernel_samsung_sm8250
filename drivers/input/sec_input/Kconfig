## drivers/input/sec_input/Kconfig
```kconfig
#
# SEC Input device configuration
#

config INPUT_SEC_INPUT
	tristate "Support for SEC input layer"
	default n
	help
	  Say Y here if you want to use sec cmd.

config SEC_DEBUG_TSP_LOG
	tristate "Support for tsp_msg"
	help
	  Say Y here if you want to use tsp_msg node.

config INPUT_TOUCHSCREEN_TCLMV2
	bool "touchscreen tclmv2"
	help
	  Say Y here if you want to use tclm.

config INPUT_SEC_SECURE_TOUCH
	bool "input sec secure touch"
	depends on INPUT
	help
	  Say Y here if you need to use sec secure touch.

config TOUCHSCREEN_DUMP_MODE
	bool "touchscreen dump mode"
	help
	  Say Y here if you need to get raw data.

source "drivers/input/sec_input/slsi/Kconfig"
```

## drivers/input/sec_input_v2/stm/Kconfig
```kconfig
# SPDX-License-Identifier: GPL-2.0-only
#
# SLSI TOUCH driver configuration
#

config TOUCHSCREEN_STM
	tristate "STM Touchscreen"
	depends on I2C
	select INPUT_SEC_INPUT_V2
    help
      Say Y here if you want support for SEC touchscreen controllers.
      If unsure, say N.

config TOUCHSCREEN_STM_SPI
    tristate "STM SPI Touchscreen"
    depends on SPI
  	select INPUT_SEC_INPUT_V2
    help
      Say Y here if you want support for STM SPI touchscreen controllers.
      If unsure, say N.
```

## drivers/input/touchscreen/novatek/nt36523/Kconfig
```kconfig
#
# Novatek NT36xxx touchscreen driver configuration
#

config TOUCHSCREEN_NOVATEK_NT36523_TABLET_I2C
	tristate "Novatek NT36523"
	depends on I2C
	select INPUT_SEC_INPUT_V2
	help
	  Say Y here if you have a Novatek NT36523 touchscreen connected
	  to your system.

	  If unsure, say N.
```

## drivers/input/touchscreen/stm/fts1ba90a/Kconfig
```kconfig
#
# STMicroelectronics TOUCH driver configuration
#

config TOUCHSCREEN_STM_FTS1BA90A
	tristate "STMicroelectronics i2c multitouch touchscreen with FingerTipS"
	depends on I2C
	select INPUT_SEC_INPUT_V2
	help
		Say Y here to enable STMicroelectronics touchscreen support.
		If unsure, say N.
		To compile this driver as a module, choose M here: the
		module will be called STM_ts.
```

## drivers/input/touchscreen/zinitix/zt7650/Kconfig
```kconfig
#
# Zinitix Touchscreen driver configuration
#

config TOUCHSCREEN_ZINITIX_ZT7650
	bool "ZINITIX ZT7650 touchscreen driver"
	depends on I2C
	select INPUT_SEC_INPUT_V2
	default n
	help
	  Say Y here if you have a ZINITIX ZT7650 touchscreen.
	  If unsure, say N.
```

## drivers/perf_mgr/Kconfig
```kconfig
menu "samsung Performance manager"

config PERF_MGR
		tristate "performance manager Driver"
		default n
		help
		  samsung performance manager driver

endmenu
```

## techpack/Kconfig
```kconfig
menu "Tech packages"

menu "Samsung techpack packages"

config TECHPACK_CAMERA_SAMSUNG
    bool "Samsung camera"
    help
      Samsung provided camera package.

endmenu

endmenu
```
